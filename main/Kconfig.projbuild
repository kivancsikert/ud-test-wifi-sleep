## main/Kconfig.projbuild
```kconfig
menu "Example Configuration"

    config ESP_WIFI_SSID
        string "WiFi SSID"
        help
            SSID (network name) for the example to connect to.

    config ESP_WIFI_PASSWORD
        string "WiFi Password"
        help
            WiFi password (WPA or WPA2) for the example to use.

    config ESP_MQTT_BROKER_URI
        string "MQTT Broker URI"
        help
            The URI of the MQTT server.

endmenu
```

## sdkconfig.defaults
```kconfig
# Won't compile without this
CONFIG_FREERTOS_HZ=1000
CONFIG_PM_ENABLE=y
CONFIG_FREERTOS_USE_TICKLESS_IDLE=y
CONFIG_PM_LIGHT_SLEEP_CALLBACKS=y

CONFIG_ESP_PHY_MAC_BB_PD=y
CONFIG_ESP_WIFI_ENHANCED_LIGHT_SLEEP=y
```
